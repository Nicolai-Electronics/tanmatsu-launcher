## components/esp_hosted/examples/host_bluedroid_bt_hid_mouse_device/sdkconfig.defaults
```kconfig
#
# BT config
#
CONFIG_BT_ENABLED=y
CONFIG_BTDM_CTRL_MODE_BLE_ONLY=n
CONFIG_BTDM_CTRL_MODE_BR_EDR_ONLY=y
CONFIG_BTDM_CTRL_MODE_BTDM=n
CONFIG_BT_CLASSIC_ENABLED=y
CONFIG_BT_HID_ENABLED=y
CONFIG_BT_HID_DEVICE_ENABLED=y

#
# Wi-Fi Remote
#
CONFIG_ESP_WIFI_REMOTE_LIBRARY_HOSTED=y

#
# Enable ESP Hosted BT
# Used as VHCI transport between BT Host and Controller
#
CONFIG_ESP_HOSTED_ENABLE_BT_BLUEDROID=y
CONFIG_ESP_HOSTED_BLUEDROID_HCI_VHCI=y
```

## components/esp_hosted/examples/host_bluedroid_host_only/sdkconfig.defaults
```kconfig
#
# BT config
#
CONFIG_BT_CONTROLLER_DISABLED=y
CONFIG_BT_ENABLED=y
CONFIG_BT_BLUEDROID_ENABLED=y
CONFIG_BT_CLASSIC_ENABLED=y

#
# Wi-Fi Remote
#
CONFIG_ESP_WIFI_REMOTE_LIBRARY_HOSTED=y

#
# Enable ESP Hosted BT
# Used as VHCI transport between BT Host and Controller
#
CONFIG_ESP_HOSTED_ENABLE_BT_BLUEDROID=y
CONFIG_ESP_HOSTED_BLUEDROID_HCI_VHCI=
```

## main/Kconfig
```kconfig
menu "Fast FATFS I/O"

    config FATFS_USE_FASTOPEN
        bool "Enable fast file I/O with DMA buffers"
        default n
        help
            Allocate stdio buffers in internal DMA-capable RAM for faster
            SD card and internal flash access, avoiding PSRAM cache overhead.

    config FATFS_MAX_FILES_OPEN
        int "Maximum files with fast I/O buffers"
        depends on FATFS_USE_FASTOPEN
        default 8
        range 1 32
        help
            Maximum number of concurrently open files using fast I/O buffers.

    config FATFS_STDIO_BUF_SIZE
        int "Fast I/O buffer size (bytes)"
        depends on FATFS_USE_FASTOPEN
        default 8192
        help
            Size of stdio buffer for fast file I/O. Must be power of 2.

endmenu
```
